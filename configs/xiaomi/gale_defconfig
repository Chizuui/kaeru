## configs/xiaomi/gale_defconfig
```kconfig
CONFIG_APP_ADDRESS=0x4C42BA40
CONFIG_BOOTLOADER_BASE=0x4C400000
CONFIG_BOOTLOADER_SIZE=0x1708F8
CONFIG_BOOTMODE_ADDRESS=0x4C5735A4
CONFIG_CERT_BYPASS=y
CONFIG_DPRINTF_ADDRESS=0x4C43CC10
CONFIG_ENVIRONMENT_SUPPORT=y
CONFIG_FASTBOOT_INFO_ADDRESS=0x4C42C4F4
CONFIG_FASTBOOT_FAIL_ADDRESS=0x4C42C6A4
CONFIG_FASTBOOT_OKAY_ADDRESS=0x4C42C884
CONFIG_FASTBOOT_PUBLISH_ADDRESS=0x4C42C180
CONFIG_FASTBOOT_REGISTER_ADDRESS=0x4C42C144
CONFIG_FREE_ADDRESS=0x4C43D040
CONFIG_GET_ENV_ADDRESS=0x4C45932C
CONFIG_INIT_STORAGE_ADDRESS=0x4C4037AC
CONFIG_INIT_STORAGE_CALLER=0x4C403A30
CONFIG_LK_LOG_STORE_ADDRESS=0x4C4520C0
CONFIG_MALLOC_ADDRESS=0x4C43D90C
CONFIG_MTK_DETECT_KEY_ADDRESS=0x4C40564C
CONFIG_PARTITION_GET_SIZE_BY_NAME_ADDRESS=0x4C459004
CONFIG_PARTITION_READ_ADDRESS=0x4C45AACC
CONFIG_PLATFORM_INIT_CALLER=0x4C426C5C
CONFIG_PLATFORM_INIT_ADDRESS=0x4C403A00
CONFIG_RECOVERY_CMDLINE1_ADDRESS=0x4C579A60
CONFIG_RECOVERY_CMDLINE2_ADDRESS=0x4C579460
CONFIG_RECOVERY_CMDLINE_PATCH=y
CONFIG_SET_ENV_ADDRESS=0x4C459544
CONFIG_SPOOF_SUPPORT=y
CONFIG_THREAD_CREATE_ADDRESS=0x4C427418
CONFIG_THREAD_RESUME_ADDRESS=0x4C42762C
CONFIG_VIDEO_PRINTF_ADDRESS=0x4C42E660
CONFIG_XIAOMI_GALE=y
CONFIG_MEDIATEK_MT6768=y
```
